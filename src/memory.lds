/* Copyright (c) 2018 SiFive, Inc */
/* SPDX-License-Identifier: Apache-2.0 */
/* SPDX-License-Identifier: GPL-2.0-or-later */
/* See the file LICENSE for further information */

MEMORY
{
  maskrom_mem (rx) : ORIGIN = 0x10000000, LENGTH = 0x10000000
}
